## config/boards/shields/kyria_dongle/Kconfig.defconfig
```kconfig
if SHIELD_KYRIA_DONGLE_CENTRAL

config ZMK_KEYBOARD_NAME
	default "Kyria"

config ZMK_SPLIT_ROLE_CENTRAL
	default y

endif

if SHIELD_KYRIA_DONGLE

config ZMK_SPLIT
	default y

endif
```

## config/boards/shields/kyria_dongle/Kconfig.shield
```kconfig
# Copyright (c) 2020 Pete Johanson
# SPDX-License-Identifier: MIT

config SHIELD_KYRIA_DONGLE
    bool

config SHIELD_KYRIA_DONGLE_CENTRAL
    def_bool $(shields_list_contains,kyria_dongle_central)
	select SHIELD_KYRIA_DONGLE

config SHIELD_KYRIA_DONGLE_LEFT
	def_bool $(shields_list_contains,kyria_dongle_left)
	select SHIELD_KYRIA_DONGLE

config SHIELD_KYRIA_DONGLE_RIGHT
	def_bool $(shields_list_contains,kyria_dongle_right)
	select SHIELD_KYRIA_DONGLE
```

## config/boards/shields/souffle/Kconfig.defconfig
```kconfig
# Copyright (c) 2022 The ZMK Contributors
# SPDX-License-Identifier: MIT

if SHIELD_SOUFFLE_CENTRAL

config ZMK_KEYBOARD_NAME
    default "souffle"

config ZMK_SPLIT_ROLE_CENTRAL
    default y

endif

if SHIELD_SOUFFLE_LEFT || SHIELD_SOUFFLE_RIGHT || SHIELD_SOUFFLE_CENTRAL
config ZMK_SPLIT
    default y
endif
```

## config/boards/shields/souffle/Kconfig.shield
```kconfig
# Copyright (c) 2022 The ZMK Contributors
# SPDX-License-Identifier: MIT

config SHIELD_SOUFFLE_CENTRAL
    def_bool $(shields_list_contains,souffle_central)

config SHIELD_SOUFFLE_LEFT
    def_bool $(shields_list_contains,souffle_left)

config SHIELD_SOUFFLE_RIGHT
    def_bool $(shields_list_contains,souffle_right)
```

## config/boards/shields/sweep/Kconfig.defconfig
```kconfig
if SHIELD_SWEEP_CENTRAL

config ZMK_KEYBOARD_NAME
	default "Sweep"

config ZMK_SPLIT_ROLE_CENTRAL
	default y

endif

if SHIELD_SWEEP

config ZMK_SPLIT
	default y

endif
```

## config/boards/shields/sweep/Kconfig.shield
```kconfig
# Copyright (c) 2020 Pete Johanson
# SPDX-License-Identifier: MIT

config SHIELD_SWEEP
    bool

config SHIELD_SWEEP_CENTRAL
    def_bool $(shields_list_contains,sweep_central)
	select SHIELD_SWEEP

config SHIELD_SWEEP_LEFT
	def_bool $(shields_list_contains,sweep_left)
	select SHIELD_SWEEP

config SHIELD_SWEEP_RIGHT
	def_bool $(shields_list_contains,sweep_right)
	select SHIELD_SWEEP
```

## config/boards/shields/swweeep/Kconfig.defconfig
```kconfig
# Copyright (c) 2022 The ZMK Contributors
# SPDX-License-Identifier: MIT

if SHIELD_SWWEEEP_CENTRAL

config ZMK_KEYBOARD_NAME
    default "swweeep"

config ZMK_SPLIT_ROLE_CENTRAL
    default y

endif

if SHIELD_SWWEEEP
config ZMK_SPLIT
    default y
endif
```

## config/boards/shields/swweeep/Kconfig.shield
```kconfig
# Copyright (c) 2022 The ZMK Contributors
# SPDX-License-Identifier: MIT

config SHIELD_SWWEEEP
    bool

config SHIELD_SWWEEEP_CENTRAL
    def_bool $(shields_list_contains,swweeep_central)
	select SHIELD_SWEEP

config SHIELD_SWWEEEP_LEFT
    def_bool $(shields_list_contains,swweeep_left)

config SHIELD_SWWEEEP_RIGHT
    def_bool $(shields_list_contains,swweeep_right)
```

## config/west.yml
```yaml
manifest:
  remotes:
    - name: zmkfirmware
      url-base: https://github.com/zmkfirmware
    - name: Benaan
      url-base: https://github.com/Benaan
  projects:
    - name: zmk
      remote: Benaan
      revision: main
      import: app/west.yml
  self:
    path: config
```
